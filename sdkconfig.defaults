## sdkconfig.defaults
```kconfig
CONFIG_IDF_TARGET="esp32s3"

# Flash: 32 MB Octal SPI (WROOM-2-N32R8V)
CONFIG_ESPTOOLPY_FLASHSIZE_32MB=y
CONFIG_ESPTOOLPY_FLASHMODE_OPI=y
CONFIG_ESPTOOLPY_FLASHFREQ_80M=y

# PSRAM: 8 MB Octal SPI
CONFIG_SPIRAM=y
CONFIG_ESP32S3_SPIRAM_SUPPORT=y
CONFIG_SPIRAM_MODE_OCT=y
CONFIG_SPIRAM_SPEED_80M=y

# FreeRTOS: 1 ms ticks — required for ±5 ms PGN interval accuracy (NFR-1.2)
CONFIG_FREERTOS_HZ=1000

# Console via UART0 (CP2102N bridge on /dev/ttyUSB0)
CONFIG_ESP_CONSOLE_UART_DEFAULT=y

# Partition table
CONFIG_PARTITION_TABLE_CUSTOM=y
CONFIG_PARTITION_TABLE_CUSTOM_FILENAME="partitions-32mb.csv"
```
